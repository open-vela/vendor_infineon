## boards/aurix/tc4d9_evb/configs/core0/defconfig
```kconfig
#include "../common/defconfig"

# CONFIG_ARCH_STACK_PROTECT is not set
# CONFIG_FS_PROCFS_EXCLUDE_NET is not set
# CONFIG_MBEDTLS_PSA_CRYPTO_C is not set
# CONFIG_NET_ETHERNET is not set
# CONFIG_NET_IGMP_CHECKSUMS is not set
# CONFIG_NET_IPV4_CHECKSUMS is not set
# CONFIG_NET_RECV_PACK is not set
# CONFIG_NSH_DISABLE_DD is not set
# CONFIG_NSH_DISABLE_IFCONFIG is not set
# CONFIG_NSH_DISABLE_IFUPDOWN is not set
# CONFIG_NSH_DISABLE_REBOOT is not set
# CONFIG_NSH_DISABLE_RESET_CAUSE is not set
CONFIG_ALLOW_BSD_COMPONENTS=y
CONFIG_ARCH_BOARD_CUSTOM_NAME="core0"
CONFIG_ARCH_NUSER_INTERRUPTS=128
CONFIG_AURIX_CAN_ERROR_POLLING=y
CONFIG_AURIX_EGTM_ATOM_ATOM0_CH0_TIMER=y
CONFIG_AURIX_EGTM_ATOM_ATOM0_CH1_TIMER=y
CONFIG_AURIX_EGTM_ATOM_ATOM0_TIMER=y
CONFIG_AURIX_EGTM_ATOM_PWM=y
CONFIG_AURIX_EGTM_ATOM_PWM_ATOM2=y
CONFIG_AURIX_EGTM_ATOM_PWM_ATOM2_CH0=y
CONFIG_AURIX_EGTM_TOM_PWM=y
CONFIG_AURIX_EGTM_TOM_PWM_TOM0=y
CONFIG_AURIX_EGTM_TOM_PWM_TOM0_CH0=y
CONFIG_AURIX_IOEXPANDER=y
CONFIG_AURIX_LIN2=y
CONFIG_AURIX_LIN4=y
CONFIG_AURIX_LIN=y
CONFIG_AURIX_MCMCAN0=y
CONFIG_AURIX_MCMCAN=y
CONFIG_AURIX_MCMCAN_ACCESS_RAM_CLOCK=500000000
CONFIG_AURIX_MCMCAN_ISR_WQUEUE=y
CONFIG_AURIX_MCMCAN_SOCKET=y
CONFIG_AURIX_MCMCAN_TXCONFIRM=y
CONFIG_AURIX_MTD_DFLASH=y
CONFIG_AURIX_MTD_FLASH=y
CONFIG_AURIX_MTD_PFLASH=y
CONFIG_AURIX_PMS=y
CONFIG_AURIX_PMS_HAVE_RTC_SUBSECONDS=y
CONFIG_AURIX_RPMSG_CORE0CORE1=y
CONFIG_AURIX_RPMSG_CORE0CORE2=y
CONFIG_AURIX_RPMSG_CORE0CORE3=y
CONFIG_AURIX_RPMSG_CORE0CORE4=y
CONFIG_AURIX_RPMSG_CORE0CORE5=y
CONFIG_AURIX_RPMSG_CORE0CORECS=y
CONFIG_AURIX_SBC_TLF4D985=y
CONFIG_AURIX_UART0=y
CONFIG_AURIX_UART_ISR_WQUEUE=y
CONFIG_AURIX_WDG=y
CONFIG_AURIX_WDG_WDTCPU0=y
CONFIG_BCH=y
CONFIG_BOARDCTL_POWEROFF=y
CONFIG_BOARDCTL_RESET=y
CONFIG_BOARDCTL_RESET_CAUSE=y
CONFIG_BOARD_RESET_ON_ASSERT=2
CONFIG_CAN_ERROR_POLLING_CYCLE=4
CONFIG_CAN_PREALLOC_CONNS=3
CONFIG_CAPTURE=y
CONFIG_DEBUG_CUSTOMOPT=y
CONFIG_DEBUG_TIMER=y
CONFIG_DEBUG_TIMER_ERROR=y
CONFIG_DEV_GPIO=y
CONFIG_DEV_RPMSG=y
CONFIG_DFX=y
CONFIG_DFX_DAEMON=y
CONFIG_DFX_LOG_ERROR=y
CONFIG_DFX_TOOL=y
CONFIG_DRIVERS_NOTERAM=y
CONFIG_DRIVERS_NOTERPMSG_SERVER=y
CONFIG_DRIVERS_NOTE_MAX=4
CONFIG_GPIO_LOWER_HALF=y
CONFIG_IOB_BUFSIZE=88
CONFIG_IOB_NBUFFERS=50
CONFIG_IOB_NCHAINS=50
CONFIG_LIBC_IPv4_ADDRCONV=y
CONFIG_MTD=y
CONFIG_MTD_CONFIG_BLOCKSIZE_MULTIPLE=8
CONFIG_MTD_CONFIG_BUFFER_SIZE=32
CONFIG_MTD_CONFIG_NAMED=y
CONFIG_MTD_CONFIG_NAME_LEN=64
CONFIG_MTD_CONFIG_NVS2=y
CONFIG_MTD_PARTITION=y
CONFIG_MTD_PARTITION_NAMES=y
CONFIG_NET=y
CONFIG_NETDEV_CAN_FILTER_IOCTL=y
CONFIG_NETDEV_CAN_STATE_IOCTL=y
CONFIG_NETDEV_IFINDEX=y
CONFIG_NETINIT_NETLOCAL=y
CONFIG_NET_CAN=y
CONFIG_NET_CANPROTO_OPTIONS=y
CONFIG_NET_CAN_CANFD=y
CONFIG_NET_CAN_ERRORS=y
CONFIG_NET_CAN_HAVE_CANFD=y
CONFIG_NET_CAN_HAVE_ERRORS=y
CONFIG_NET_CAN_RAW_FILTER_MAX=2
CONFIG_NET_CAN_SOCK_OPTS=y
CONFIG_NET_CAN_WRITE_BUFFERS=y
CONFIG_NET_IPv4=y
CONFIG_NET_LOCAL=y
CONFIG_NET_MAX_RECV_BUFSIZE=0
CONFIG_NET_RECV_BUFSIZE=1056
CONFIG_NET_SEND_BUFSIZE=1056
CONFIG_NET_SOCKOPTS=y
CONFIG_NET_USRSOCK=y
CONFIG_NET_USRSOCK_ICMP=y
CONFIG_NET_USRSOCK_RPMSG=y
CONFIG_NET_USRSOCK_RPMSG_CPUNAME="core2"
CONFIG_NET_USRSOCK_TCP=y
CONFIG_NET_USRSOCK_UDP=y
CONFIG_NSH_EXT_WDG=y
CONFIG_NSH_LINELEN=512
CONFIG_NSH_PROMPT_STRING="core0> "
CONFIG_OPENAMP_DEBUG=y
CONFIG_OS_TIMER_PATH_TRUSTED="/dev/timer0_0"
CONFIG_PREALLOC_IRQCHAIN=32
CONFIG_PWM=y
CONFIG_RAMLOG=y
CONFIG_RAMLOG_SYSLOG=y
CONFIG_RAM_START=0x70000000
CONFIG_RPMSG_LOCAL_CPUNAME="core0"
CONFIG_RPMSG_POOL_COUNT=16
CONFIG_SCHED_INSTRUMENTATION_DUMP=y
CONFIG_SCHED_INSTRUMENTATION_FILTER=y
CONFIG_SYSLOG_BUFFER=y
CONFIG_SYSLOG_DEFAULT=y
CONFIG_SYSLOG_DEVPATH="/dev/ramlog"
CONFIG_SYSLOG_INTBUFFER=y
CONFIG_SYSLOG_MAX_CHANNELS=4
CONFIG_SYSLOG_PREFIX=y
CONFIG_SYSLOG_PREFIX_STRING="core0"
CONFIG_SYSLOG_RPMSG_SERVER=y
CONFIG_SYSTEM_CUTERM=y
CONFIG_SYSTEM_CUTERM_DEFAULT_DEVICE="/dev/ttyCORE1"
CONFIG_SYSTEM_PING=y
CONFIG_TTY_FORCE_PANIC=y
CONFIG_TTY_SIGINT=y
CONFIG_UART0_SERIAL_CONSOLE=y
CONFIG_WATCHDOG=y
CONFIG_ARCH_CHIP_TC4XX=y
```

## boards/aurix/tc4d9_evb/configs/core1/defconfig
```kconfig
#include "../common/defconfig"

# CONFIG_ADC=y
# CONFIG_ARCH_LOWPUTC is not set
# CONFIG_FS_PROCFS_EXCLUDE_NET is not set
# CONFIG_NSH_DISABLE_ARP is not set
# CONFIG_NSH_DISABLE_IFCONFIG is not set
# CONFIG_NSH_DISABLE_IFUPDOWN is not set
# CONFIG_NSH_DISABLE_VCONFIG is not set
CONFIG_ALLOW_BSD_COMPONENTS=y
CONFIG_ANALOG=y
CONFIG_ARCH_BOARD_CUSTOM_NAME="core1"
CONFIG_ARCH_DCACHE_ADDR=0x6003C000
CONFIG_AURIX_CAN_ERROR_POLLING=y
CONFIG_AURIX_EGTM_ATOM_ATOM0_CH4_TIMER=y
CONFIG_AURIX_EGTM_ATOM_ATOM0_CH5_TIMER=y
CONFIG_AURIX_EGTM_ATOM_ATOM0_TIMER=y
CONFIG_AURIX_EGTM_TOM_PWM=y
CONFIG_AURIX_EGTM_TOM_PWM_TOM0=y
CONFIG_AURIX_EGTM_TOM_PWM_TOM1=y
CONFIG_AURIX_EGTM_TOM_PWM_TOM2=y
CONFIG_AURIX_IOEXPANDER=y
CONFIG_AURIX_MCMCAN=y
CONFIG_AURIX_MCMCAN_ACCESS_RAM_CLOCK=500000000
CONFIG_AURIX_MCMCAN_ISR_WQUEUE=y
CONFIG_AURIX_MCMCAN_SOCKET=y
CONFIG_AURIX_MCMCAN_TXCONFIRM=y
CONFIG_AURIX_RPMSG_CORE0CORE1=y
CONFIG_AURIX_UART0=y
CONFIG_AURIX_UART=y
CONFIG_AURIX_UART_ISR_WQUEUE=y
CONFIG_CAN_ERROR_POLLING_CYCLE=4
CONFIG_CAN_PREALLOC_CONNS=10
CONFIG_CLOCK_ADJTIME=y
CONFIG_CPU_COREID=1
CONFIG_DEV_GPIO=y
CONFIG_DRIVERS_NOTERPMSG=y
CONFIG_DRIVERS_NOTERPMSG_SERVER_NAME="core0"
CONFIG_DRIVERS_NOTE_MAX=2
CONFIG_GPIO_LOWER_HALF=y
CONFIG_IOB_BUFSIZE=512
CONFIG_IOEXPANDER_MULTIPIN=y
CONFIG_NET=y
CONFIG_NETDEV_CAN_FILTER_IOCTL=y
CONFIG_NETDEV_CAN_STATE_IOCTL=y
CONFIG_NETDEV_PHY_IOCTL=y
CONFIG_NETINIT_NETLOCAL=y
CONFIG_NET_ARP_GRATUITOUS=y
CONFIG_NET_ARP_MAXAGE=30
CONFIG_NET_BROADCAST=y
CONFIG_NET_CANPROTO_OPTIONS=y
CONFIG_NET_CAN_CANFD=y
CONFIG_NET_CAN_ERRORS=y
CONFIG_NET_CAN_HAVE_CANFD=y
CONFIG_NET_CAN_HAVE_ERRORS=y
CONFIG_NET_CAN_RAW_FILTER_MAX=2
CONFIG_NET_CAN_SOCK_OPTS=y
CONFIG_NET_ETH_PKTSIZE=1514
CONFIG_NET_ICMP=y
CONFIG_NET_ICMP_SOCKET=y
CONFIG_NET_IGMP=y
CONFIG_NET_IPFILTER=y
CONFIG_NET_IPTABLES=y
CONFIG_NET_IPv4=y
CONFIG_NET_MAX_RECV_BUFSIZE=0
CONFIG_NET_PKT=y
CONFIG_NET_PKT_PREALLOC_CONNS=8
CONFIG_NET_PKT_WRITE_BUFFERS=y
CONFIG_NET_PREALLOC_DEVIF_CALLBACKS=32
CONFIG_NET_RECV_BUFSIZE=2304
CONFIG_NET_SEND_BUFSIZE=16348
CONFIG_NET_SOCKOPTS=y
CONFIG_NET_SOLINGER=y
CONFIG_NET_TCP=y
CONFIG_NET_TCPBACKLOG=y
CONFIG_NET_TCPPROTO_OPTIONS=y
CONFIG_NET_TCP_CHECKSUMS=y
CONFIG_NET_TCP_DELAYED_ACK=y
CONFIG_NET_TCP_FIXED_RTO=y
CONFIG_NET_TCP_KEEPALIVE=y
CONFIG_NET_TCP_OUT_OF_ORDER=y
CONFIG_NET_TCP_RTO=1
CONFIG_NET_TCP_WRITE_BUFFERS=y
CONFIG_NET_TIMESTAMP=y
CONFIG_NET_UDP=y
CONFIG_NET_UDP_CHECKSUMS=y
CONFIG_NET_UDP_PREALLOC_CONNS=16
CONFIG_NET_UDP_WRITE_BUFFERS=y
CONFIG_NET_VLAN=y
CONFIG_NET_VLAN_COUNT=8
CONFIG_NSH_LINELEN=256
CONFIG_NSH_PROMPT_STRING="core1> "
CONFIG_OS_TIMER_PATH_TRUSTED="/dev/qbv_schedu"
CONFIG_PTP_CLOCK=y
CONFIG_PWM=y
CONFIG_RAM_START=0x60000000
CONFIG_RPMSG_LOCAL_CPUNAME="core1"
CONFIG_RPMSG_UART_CONSOLE=y
CONFIG_SCHED_INSTRUMENTATION_DUMP=y
CONFIG_SCHED_INSTRUMENTATION_FILTER=y
CONFIG_STANDARD_SERIAL=y
CONFIG_SYSLOG_PREFIX=y
CONFIG_SYSLOG_PREFIX_STRING="core1"
CONFIG_SYSLOG_RPMSG=y
CONFIG_SYSLOG_RPMSG_BUFFER_SECTION=".syslog"
CONFIG_SYSLOG_RPMSG_BUFSIZE=8192
CONFIG_SYSLOG_RPMSG_SERVER_NAME="core0"
CONFIG_SYSTEM_IPTABLES=y
CONFIG_SYSTEM_NSH_STACKSIZE=5120
CONFIG_SYSTEM_PING=y
CONFIG_SYSTEM_PTPD=y
CONFIG_SYSTEM_PTPD_PRIORITY=220
CONFIG_SYSTEM_PTPD_STACKSIZE=4096
CONFIG_SYSTEM_SYSTEM=y
CONFIG_ARCH_CHIP_TC4XX=y
```

## boards/aurix/tc4d9_evb/configs/core2/defconfig
```kconfig
#include "../common/defconfig"

# CONFIG_ARCH_LOWPUTC is not set
# CONFIG_ARCH_STACK_PROTECT is not set
# CONFIG_FS_PROCFS_EXCLUDE_NET is not set
# CONFIG_NET_ICMP_CHECKSUMS is not set
# CONFIG_NET_TCP_CHECKSUMS is not set
# CONFIG_NET_UDP_CHECKSUMS is not set
# CONFIG_NSH_DISABLE_ARP is not set
# CONFIG_NSH_DISABLE_IFCONFIG is not set
# CONFIG_NSH_DISABLE_IFUPDOWN is not set
# CONFIG_NSH_DISABLE_VCONFIG is not set
CONFIG_ALLOW_BSD_COMPONENTS=y
CONFIG_ARCH_BOARD_CUSTOM_NAME="core2"
CONFIG_ARCH_DCACHE_ADDR=0x5003C000
CONFIG_AURIX_EGTM_ATOM_ATOM0_CH6_TIMER=y
CONFIG_AURIX_EGTM_ATOM_ATOM0_CH7_TIMER=y
CONFIG_AURIX_EGTM_ATOM_ATOM0_TIMER=y
CONFIG_AURIX_EGTM_ATOM_PWM=y
CONFIG_AURIX_EGTM_ATOM_PWM_ATOM2=y
CONFIG_AURIX_EGTM_TOM_PWM=y
CONFIG_AURIX_EGTM_TOM_PWM_TOM1=y
CONFIG_AURIX_IOEXPANDER=y
CONFIG_AURIX_RPTUN_CORE0CORE2=y
CONFIG_CPU_COREID=2
CONFIG_DEV_GPIO=y
CONFIG_GPIO_LOWER_HALF=y
CONFIG_IOB_BUFSIZE=512
CONFIG_NET=y
CONFIG_NETDEV_PHY_IOCTL=y
CONFIG_NETINIT_NETLOCAL=y
CONFIG_NET_ARP_MAXAGE=30
CONFIG_NET_BROADCAST=y
CONFIG_NET_ETH_PKTSIZE=1514
CONFIG_NET_ICMP=y
CONFIG_NET_ICMP_SOCKET=y
CONFIG_NET_IGMP=y
CONFIG_NET_IPFILTER=y
CONFIG_NET_IPTABLES=y
CONFIG_NET_IPv4=y
CONFIG_NET_PKT=y
CONFIG_NET_PKT_PREALLOC_CONNS=8
CONFIG_NET_PKT_WRITE_BUFFERS=y
CONFIG_NET_PREALLOC_DEVIF_CALLBACKS=8
CONFIG_NET_RECV_BUFSIZE=16384
CONFIG_NET_SEND_BUFSIZE=16384
CONFIG_NET_SOCKOPTS=y
CONFIG_NET_TCP=y
CONFIG_NET_TCPBACKLOG=y
CONFIG_NET_TCPPROTO_OPTIONS=y
CONFIG_NET_TCP_KEEPALIVE=y
CONFIG_NET_TCP_WRITE_BUFFERS=y
CONFIG_NET_TIMESTAMP=y
CONFIG_NET_UDP=y
CONFIG_NET_UDP_WRITE_BUFFERS=y
CONFIG_NET_USRSOCK_RPMSG_SERVER=y
CONFIG_NET_VLAN=y
CONFIG_NET_VLAN_COUNT=8
CONFIG_NSH_LINELEN=256
CONFIG_NSH_PROMPT_STRING="core2> "
CONFIG_OS_TIMER_PATH_TRUSTED="/dev/timer0_6"
CONFIG_PWM=y
CONFIG_RAM_START=0x50000000
CONFIG_RPMSG_LOCAL_CPUNAME="core2"
CONFIG_RPMSG_UART_CONSOLE=y
CONFIG_SCHED_INSTRUMENTATION_DUMP=y
CONFIG_SCHED_INSTRUMENTATION_FILTER=y
CONFIG_SYSLOG_PREFIX=y
CONFIG_SYSLOG_PREFIX_STRING="core2"
CONFIG_SYSLOG_RPMSG=y
CONFIG_SYSLOG_RPMSG_BUFFER_SECTION=".syslog"
CONFIG_SYSLOG_RPMSG_BUFSIZE=8192
CONFIG_SYSLOG_RPMSG_SERVER_NAME="core0"
CONFIG_ARCH_CHIP_TC4XX=y
```

## boards/aurix/tc4d9_evb/configs/core3/defconfig
```kconfig
#include "../common/defconfig"

# CONFIG_ARCH_LOWPUTC is not set
CONFIG_ANALOG=y
CONFIG_ARCH_BOARD_CUSTOM_NAME="core3"
CONFIG_ARCH_DCACHE_ADDR=0x4003C000
CONFIG_AURIX_ADC_ISR_WQUEUE=y
CONFIG_AURIX_EGTM_ATOM_ATOM1_CH0_TIMER=y
CONFIG_AURIX_EGTM_ATOM_ATOM1_CH1_TIMER=y
CONFIG_AURIX_EGTM_ATOM_ATOM1_TIMER=y
CONFIG_AURIX_EGTM_ATOM_PWM=y
CONFIG_AURIX_EGTM_ATOM_PWM_ATOM2=y
CONFIG_AURIX_EGTM_ATOM_PWM_ATOM2_CH5=y
CONFIG_AURIX_EGTM_TOM_PWM=y
CONFIG_AURIX_EGTM_TOM_PWM_TOM1=y
CONFIG_AURIX_EGTM_TOM_PWM_TOM1_CH6=y
CONFIG_AURIX_IOEXPANDER=y
CONFIG_AURIX_RPMSG_CORE0CORE3=y
CONFIG_CAPTURE=y
CONFIG_CPU_COREID=3
CONFIG_DEV_GPIO=y
CONFIG_DRIVERS_NOTERPMSG=y
CONFIG_DRIVERS_NOTERPMSG_SERVER_NAME="core0"
CONFIG_DRIVERS_NOTE_MAX=2
CONFIG_GPIO_LOWER_HALF=y
CONFIG_MCU_SERVICE=y
CONFIG_NSH_PROMPT_STRING="core3> "
CONFIG_OS_TIMER_PATH_TRUSTED="/dev/timer1_0"
CONFIG_PWM=y
CONFIG_RAM_START=0x40000000
CONFIG_RPMSG_LOCAL_CPUNAME="core3"
CONFIG_RPMSG_UART_CONSOLE=y
CONFIG_SCHED_INSTRUMENTATION_DUMP=y
CONFIG_SCHED_INSTRUMENTATION_FILTER=y
CONFIG_SPI=y
CONFIG_SPI_DRIVER=y
CONFIG_SYSLOG_PREFIX=y
CONFIG_SYSLOG_PREFIX_STRING="core3"
CONFIG_SYSLOG_RPMSG=y
CONFIG_SYSLOG_RPMSG_BUFFER_SECTION=".syslog"
CONFIG_SYSLOG_RPMSG_BUFSIZE=8192
CONFIG_SYSLOG_RPMSG_SERVER_NAME="core0"
CONFIG_ARCH_CHIP_TC4XX=y
```

## boards/aurix/tc4d9_evb/configs/core4/defconfig
```kconfig
#include "../common/defconfig"

# CONFIG_ARCH_LOWPUTC is not set
CONFIG_ARCH_BOARD_CUSTOM_NAME="core4"
CONFIG_ARCH_DCACHE_ADDR=0x3003C000
CONFIG_AURIX_EGTM_ATOM_ATOM1_CH2_TIMER=y
CONFIG_AURIX_EGTM_ATOM_ATOM1_CH3_TIMER=y
CONFIG_AURIX_EGTM_ATOM_ATOM1_TIMER=y
CONFIG_AURIX_EGTM_ATOM_PWM=y
CONFIG_AURIX_EGTM_ATOM_PWM_ATOM2=y
CONFIG_AURIX_EGTM_ATOM_PWM_ATOM2_CH6=y
CONFIG_AURIX_EGTM_TOM_PWM=y
CONFIG_AURIX_EGTM_TOM_PWM_TOM2=y
CONFIG_AURIX_EGTM_TOM_PWM_TOM2_CH0=y
CONFIG_AURIX_IOEXPANDER=y
CONFIG_AURIX_RPMSG_CORE0CORE4=y
CONFIG_CAPTURE=y
CONFIG_CPU_COREID=4
CONFIG_DEV_GPIO=y
CONFIG_DRIVERS_NOTERPMSG=y
CONFIG_DRIVERS_NOTERPMSG_SERVER_NAME="core0"
CONFIG_DRIVERS_NOTE_MAX=2
CONFIG_GPIO_LOWER_HALF=y
CONFIG_MCU_SERVICE=y
CONFIG_NSH_PROMPT_STRING="core4> "
CONFIG_OS_TIMER_PATH_TRUSTED="/dev/timer1_2"
CONFIG_PWM=y
CONFIG_RAM_START=0x30000000
CONFIG_RPMSG_LOCAL_CPUNAME="core4"
CONFIG_RPMSG_UART_CONSOLE=y
CONFIG_SCHED_INSTRUMENTATION_DUMP=y
CONFIG_SCHED_INSTRUMENTATION_FILTER=y
CONFIG_SYSLOG_PREFIX=y
CONFIG_SYSLOG_PREFIX_STRING="core4"
CONFIG_SYSLOG_RPMSG=y
CONFIG_SYSLOG_RPMSG_BUFFER_SECTION=".syslog"
CONFIG_SYSLOG_RPMSG_BUFSIZE=8192
CONFIG_SYSLOG_RPMSG_SERVER_NAME="core0"
CONFIG_ARCH_CHIP_TC4XX=y
```

## boards/aurix/tc4d9_evb/configs/core5/defconfig
```kconfig
#include "../common/defconfig"

# CONFIG_ARCH_LOWPUTC is not set
CONFIG_ARCH_BOARD_CUSTOM_NAME="core5"
CONFIG_ARCH_DCACHE_ADDR=0x2003C000
CONFIG_AURIX_EGTM_ATOM_ATOM1_CH4_TIMER=y
CONFIG_AURIX_EGTM_ATOM_ATOM1_CH5_TIMER=y
CONFIG_AURIX_EGTM_ATOM_ATOM1_TIMER=y
CONFIG_AURIX_IOEXPANDER=y
CONFIG_AURIX_RPMSG_CORE0CORE5=y
CONFIG_CPU_COREID=5
CONFIG_DEV_GPIO=y
CONFIG_DRIVERS_NOTERPMSG=y
CONFIG_DRIVERS_NOTERPMSG_SERVER_NAME="core0"
CONFIG_DRIVERS_NOTE_MAX=2
CONFIG_GPIO_LOWER_HALF=y
CONFIG_MCU_SERVICE=y
CONFIG_NSH_PROMPT_STRING="core5> "
CONFIG_OS_TIMER_PATH_TRUSTED="/dev/timer1_4"
CONFIG_RAM_START=0x20000000
CONFIG_RPMSG_LOCAL_CPUNAME="core5"
CONFIG_RPMSG_UART_CONSOLE=y
CONFIG_SCHED_INSTRUMENTATION_DUMP=y
CONFIG_SCHED_INSTRUMENTATION_FILTER=y
CONFIG_SYSLOG_PREFIX=y
CONFIG_SYSLOG_PREFIX_STRING="core5"
CONFIG_SYSLOG_RPMSG=y
CONFIG_SYSLOG_RPMSG_BUFFER_SECTION=".syslog"
CONFIG_SYSLOG_RPMSG_BUFSIZE=8192
CONFIG_SYSLOG_RPMSG_SERVER_NAME="core0"
CONFIG_ARCH_CHIP_TC4XX=y
```

## boards/aurix_tc3/tc397_evb/configs/core0/defconfig
```kconfig
#include "../common/defconfig"
# CONFIG_FS_PROCFS_EXCLUDE_NET is not set
# CONFIG_NET_ETHERNET is not set
# CONFIG_NET_IGMP_CHECKSUMS is not set
# CONFIG_NET_IPV4_CHECKSUMS is not set
# CONFIG_NET_IPv4 is not set
# CONFIG_NET_RECV_PACK is not set
# CONFIG_NSH_DISABLE_DD is not set
# CONFIG_NSH_DISABLE_IFCONFIG is not set
# CONFIG_NSH_DISABLE_IFUPDOWN is not set
# CONFIG_NSH_DISABLE_REBOOT is not set
CONFIG_ALLOW_BSD_COMPONENTS=y
CONFIG_ARCH_BOARD_CUSTOM_NAME="core0"
CONFIG_ARCH_NUSER_INTERRUPTS=128
CONFIG_AURIX_UART0=y
CONFIG_TTY_FORCE_PANIC=y
CONFIG_TTY_SIGINT=y
CONFIG_UART0_SERIAL_CONSOLE=y
```
